/*@!Encoding:1252*/
/*
 * hexray rest-bus simulation for Vector CANoe.
 *
 * AUTO-GENERATED by can_bus/canoe/generate_capl.py. Do not edit by hand; rerun the script
 * after changing can_bus/hexray/*.json. Generated from: can_bus/hexray @ 57f437984
 *
 * Setup:
 *   - Add hexray_canoe.dbc to the CANoe configuration and assign it to every channel below.
 *   - FDCAN: 1000 kbit/s, CAN FD, BRS off (data rate = arbitration rate) -> CH_FDCAN
 *   - InvCAN: 1000 kbit/s, classic CAN -> CH_INVCAN
 *   - charger: 500 kbit/s, classic CAN -> CH_CHARGER
 *   - Add this file as a CAPL node in the Simulation Setup (any channel; each send sets .CAN).
 *   - Set gSim_<Node> = 0 for every node that is real hardware on the bench.
 *
 * Timing mirrors the firmware: every periodic message is sent at each multiple of its
 * GenMsgCycleTime from measurement start, on the bus(es) its owner sends it on. When a
 * forwarding node (VC, BMS) is simulated it also forwards the messages it reroutes in the
 * firmware, both from simulated nodes and from real hardware.
 * Signals start at GenSigStartValue; every <Node>_Heartbeat is driven to 1.
 */

includes
{
}

variables
{
  // ---- CANoe channel per bus: edit to match your hardware/channel mapping ----
  const int CH_FDCAN = 1;
  const int CH_INVCAN = 2;
  const int CH_CHARGER = 3;

  // ---- Which transmitters to simulate (1 = CANoe sends its messages) ----
  int gSim_BMS = 1;
  int gSim_Boot = 0;
  int gSim_CRIT = 1;
  int gSim_DAM = 1;
  int gSim_Debug = 0;
  int gSim_EMeter = 1;
  int gSim_Elcon = 1;
  int gSim_FSM = 1;
  int gSim_INVFL = 1;
  int gSim_INVFR = 1;
  int gSim_INVRL = 1;
  int gSim_INVRR = 1;
  int gSim_RSM = 1;
  int gSim_VC = 1;

  // ---- One cyclic timer per distinct cycle time ----
  msTimer tCycle_10ms;
  msTimer tCycle_20ms;
  msTimer tCycle_100ms;
  msTimer tCycle_250ms;
  msTimer tCycle_1000ms;

  // ---- Periodic messages ----
  message BMS_Vitals m_BMS_Vitals;
  message BMS_Faults m_BMS_Faults;
  message BMS_Warnings m_BMS_Warnings;
  message BMS_FaultsCounts m_BMS_FaultsCounts;
  message BMS_WarningsCounts m_BMS_WarningsCounts;
  message BMS_Info m_BMS_Info;
  message BMS_InfoCounts m_BMS_InfoCounts;
  message BMS_Debug m_BMS_Debug;
  message BMS_CommitInfo m_BMS_CommitInfo;
  message BMS_LatchStatus m_BMS_LatchStatus;
  message BMS_Contactors m_BMS_Contactors;
  message BMS_Charger m_BMS_Charger;
  message BMS_TractiveSystem m_BMS_TractiveSystem;
  message BMS_BSPDStatus m_BMS_BSPDStatus;
  message BMS_HvBatteryProperties m_BMS_HvBatteryProperties;
  message BMS_ImdStatus m_BMS_ImdStatus;
  message BMS_ImdData m_BMS_ImdData;
  message BMS_PowerLimit m_BMS_PowerLimit;
  message BMS_Fans m_BMS_Fans;
  message BMS_BMSShdnNodeStatus m_BMS_BMSShdnNodeStatus;
  message BMS_CPUDataLogInfo m_BMS_CPUDataLogInfo;
  message BMS_EvseCPStatus m_BMS_EvseCPStatus;
  message BMS_ElconControls m_BMS_ElconControls;
  message Boot_BMS_Status m_Boot_BMS_Status;
  message Boot_VC_Status m_Boot_VC_Status;
  message Boot_DAM_Status m_Boot_DAM_Status;
  message Boot_FSM_Status m_Boot_FSM_Status;
  message Boot_RSM_Status m_Boot_RSM_Status;
  message Boot_CRIT_Status m_Boot_CRIT_Status;
  message CRIT_Vitals m_CRIT_Vitals;
  message CRIT_Debug m_CRIT_Debug;
  message CRIT_CommitInfo m_CRIT_CommitInfo;
  message CRIT_ButtonsAndSwitches m_CRIT_ButtonsAndSwitches;
  message CRIT_Warnings m_CRIT_Warnings;
  message CRIT_Faults m_CRIT_Faults;
  message CRIT_WarningsCounts m_CRIT_WarningsCounts;
  message CRIT_FaultsCounts m_CRIT_FaultsCounts;
  message CRIT_Info m_CRIT_Info;
  message CRIT_InfoCounts m_CRIT_InfoCounts;
  message CRIT_CPUDataLogInfo m_CRIT_CPUDataLogInfo;
  message DAM_Vitals m_DAM_Vitals;
  message DAM_Warnings m_DAM_Warnings;
  message DAM_Faults m_DAM_Faults;
  message DAM_WarningsCounts m_DAM_WarningsCounts;
  message DAM_FaultsCounts m_DAM_FaultsCounts;
  message DAM_Info m_DAM_Info;
  message DAM_InfoCounts m_DAM_InfoCounts;
  message DAM_Debug m_DAM_Debug;
  message DAM_CommitInfo m_DAM_CommitInfo;
  message DAM_ShdnNodeStatus m_DAM_ShdnNodeStatus;
  message DAM_CPUDataLogInfo m_DAM_CPUDataLogInfo;
  message Debug_CanMode m_Debug_CanMode;
  message Debug_Charging m_Debug_Charging;
  message Debug_CellBalancing m_Debug_CellBalancing;
  message Debug_ResetSoc m_Debug_ResetSoc;
  message Debug_SetBSPDTestCurrent m_Debug_SetBSPDTestCurrent;
  message Debug_SetTorqueRequest m_Debug_SetTorqueRequest;
  message EMeter_Measurement m_EMeter_Measurement;
  message EMeter_Status m_EMeter_Status;
  message EMeter_Temperature m_EMeter_Temperature;
  message Elcon_Vitals m_Elcon_Vitals;
  message FSM_Vitals m_FSM_Vitals;
  message FSM_Warnings m_FSM_Warnings;
  message FSM_Faults m_FSM_Faults;
  message FSM_WarningsCounts m_FSM_WarningsCounts;
  message FSM_FaultsCounts m_FSM_FaultsCounts;
  message FSM_Info m_FSM_Info;
  message FSM_InfoCounts m_FSM_InfoCounts;
  message FSM_Debug m_FSM_Debug;
  message FSM_CommitInfo m_FSM_CommitInfo;
  message FSM_Steering m_FSM_Steering;
  message FSM_Apps m_FSM_Apps;
  message FSM_Brake m_FSM_Brake;
  message FSM_Suspension m_FSM_Suspension;
  message FSM_IMU m_FSM_IMU;
  message FSM_ShdnNodeStatus m_FSM_ShdnNodeStatus;
  message FSM_CPUDataLogInfo m_FSM_CPUDataLogInfo;
  message INVFL_FLInverterInfo1 m_INVFL_FLInverterInfo1;
  message INVFL_FLInverterInfo2 m_INVFL_FLInverterInfo2;
  message INVFL_FLInverterInfo3 m_INVFL_FLInverterInfo3;
  message INVFR_FRInverterInfo1 m_INVFR_FRInverterInfo1;
  message INVFR_FRInverterInfo2 m_INVFR_FRInverterInfo2;
  message INVFR_FRInverterInfo3 m_INVFR_FRInverterInfo3;
  message INVRL_RLInverterInfo1 m_INVRL_RLInverterInfo1;
  message INVRL_RLInverterInfo2 m_INVRL_RLInverterInfo2;
  message INVRL_RLInverterInfo3 m_INVRL_RLInverterInfo3;
  message INVRR_RRInverterInfo1 m_INVRR_RRInverterInfo1;
  message INVRR_RRInverterInfo2 m_INVRR_RRInverterInfo2;
  message INVRR_RRInverterInfo3 m_INVRR_RRInverterInfo3;
  message RSM_Vitals m_RSM_Vitals;
  message RSM_Faults m_RSM_Faults;
  message RSM_Warnings m_RSM_Warnings;
  message RSM_FaultsCounts m_RSM_FaultsCounts;
  message RSM_WarningsCounts m_RSM_WarningsCounts;
  message RSM_Info m_RSM_Info;
  message RSM_InfoCounts m_RSM_InfoCounts;
  message RSM_Debug m_RSM_Debug;
  message RSM_CommitInfo m_RSM_CommitInfo;
  message RSM_SuspensionTravel m_RSM_SuspensionTravel;
  message RSM_IMU m_RSM_IMU;
  message RSM_Brakes m_RSM_Brakes;
  message RSM_ShdnNodeStatus m_RSM_ShdnNodeStatus;
  message RSM_RearLeftPumpPercentage m_RSM_RearLeftPumpPercentage;
  message RSM_CPUDataLogInfo m_RSM_CPUDataLogInfo;
  message RSM_Coolant m_RSM_Coolant;
  message RSM_TireSensor m_RSM_TireSensor;
  message VC_INVFLSetPoints m_VC_INVFLSetPoints;
  message VC_INVFRSetPoints m_VC_INVFRSetPoints;
  message VC_INVRLSetPoints m_VC_INVRLSetPoints;
  message VC_INVRRSetPoints m_VC_INVRRSetPoints;
  message VC_Vitals m_VC_Vitals;
  message VC_Faults m_VC_Faults;
  message VC_Warnings m_VC_Warnings;
  message VC_FaultsCounts m_VC_FaultsCounts;
  message VC_WarningsCounts m_VC_WarningsCounts;
  message VC_Info m_VC_Info;
  message VC_InfoCounts m_VC_InfoCounts;
  message VC_Debug m_VC_Debug;
  message VC_CommitInfo m_VC_CommitInfo;
  message VC_VehicleDynamics m_VC_VehicleDynamics;
  message VC_IMU1 m_VC_IMU1;
  message VC_EllipseEkfNavVelocity m_VC_EllipseEkfNavVelocity;
  message VC_GlobalShdnNodeStatus m_VC_GlobalShdnNodeStatus;
  message VC_PumpStatus m_VC_PumpStatus;
  message VC_ConnectorBoardEfuse m_VC_ConnectorBoardEfuse;
  message VC_ShdnNodeStatus m_VC_ShdnNodeStatus;
  message VC_EllipseTime m_VC_EllipseTime;
  message VC_EllipseStatus m_VC_EllipseStatus;
  message VC_EllipseEulerAngles m_VC_EllipseEulerAngles;
  message VC_MainBoardEfuse m_VC_MainBoardEfuse;
  message VC_CPUDataLogInfo m_VC_CPUDataLogInfo;
  message VC_PCM m_VC_PCM;
}

void InitMessages()
{
  m_BMS_Vitals.BMS_Heartbeat = 1;
  m_BMS_TractiveSystem.BMS_TractiveSystemCurrent = -300;
  m_BMS_TractiveSystem.BMS_TractiveSystemPower = -100;
  m_BMS_ElconControls.BMS_StopCharging = 1;
  m_CRIT_Vitals.CRIT_Heartbeat = 1;
  m_DAM_Vitals.DAM_Heartbeat = 1;
  m_Debug_CellBalancing.Debug_CellBalancing_TargetValue = 2.5;
  m_Debug_CellBalancing.Debug_CellBalancing_TargetDutyCycle = 6.6;
  m_FSM_Vitals.FSM_Heartbeat = 1;
  m_FSM_Steering.FSM_SteeringAngle = -110;
  m_FSM_IMU.FSM_AccelX = -5;
  m_FSM_IMU.FSM_AccelY = -5;
  m_FSM_IMU.FSM_AccelZ = -5;
  m_FSM_IMU.FSM_GyroX = -250;
  m_FSM_IMU.FSM_GyroY = -250;
  m_FSM_IMU.FSM_GyroZ = -250;
  m_INVFL_FLInverterInfo2.INVFL_MotorTemperature = -1;
  m_INVFL_FLInverterInfo2.INVFL_InverterTemperature = -1;
  m_INVFL_FLInverterInfo2.INVFL_IGBTTemperature = -1;
  m_INVFR_FRInverterInfo2.INVFR_MotorTemperature = -1;
  m_INVFR_FRInverterInfo2.INVFR_InverterTemperature = -1;
  m_INVFR_FRInverterInfo2.INVFR_IGBTTemperature = -1;
  m_INVRL_RLInverterInfo2.INVRL_MotorTemperature = -1;
  m_INVRL_RLInverterInfo2.INVRL_InverterTemperature = -1;
  m_INVRL_RLInverterInfo2.INVRL_IGBTTemperature = -1;
  m_INVRR_RRInverterInfo2.INVRR_MotorTemperature = -1;
  m_INVRR_RRInverterInfo2.INVRR_InverterTemperature = -1;
  m_INVRR_RRInverterInfo2.INVRR_IGBTTemperature = -1;
  m_RSM_Vitals.RSM_Heartbeat = 1;
  m_RSM_SuspensionTravel.RSM_RearRightSuspensionTravel = -10;
  m_RSM_SuspensionTravel.RSM_RearLeftSuspensionTravel = -10;
  m_RSM_IMU.RSM_AccelX = -5;
  m_RSM_IMU.RSM_AccelY = -5;
  m_RSM_IMU.RSM_AccelZ = -5;
  m_RSM_IMU.RSM_GyroX = -250;
  m_RSM_IMU.RSM_GyroY = -250;
  m_RSM_IMU.RSM_GyroZ = -250;
  m_RSM_TireSensor.RSM_TireTemperature = -20;
  m_VC_Vitals.VC_Heartbeat = 1;
  m_VC_VehicleDynamics.VC_ReferenceYawRate = -100;
  m_VC_VehicleDynamics.VC_CorrectionYawRate = -100;
  m_VC_VehicleDynamics.VC_FrontYawMoment = -100;
  m_VC_VehicleDynamics.VC_RearYawMoment = -100;
  m_VC_IMU1.VC_Imu1AccelX = -5;
  m_VC_IMU1.VC_Imu1AccelY = -5;
  m_VC_IMU1.VC_Imu1AccelZ = -5;
  m_VC_IMU1.VC_Imu1GyroX = -250;
  m_VC_IMU1.VC_Imu1GyroY = -250;
  m_VC_IMU1.VC_Imu1GyroZ = -250;
  m_VC_EllipseEkfNavVelocity.VC_VelocityNorth = -35;
  m_VC_EllipseEkfNavVelocity.VC_VelocityNorthAccuracy = -35;
  m_VC_EllipseEkfNavVelocity.VC_VelocityEast = -35;
  m_VC_EllipseEkfNavVelocity.VC_VelocityEastAccuracy = -35;
  m_VC_EllipseEkfNavVelocity.VC_VelocityDown = -35;
  m_VC_EllipseEkfNavVelocity.VC_VelocityDownAccuracy = -35;
  m_VC_EllipseEkfNavVelocity.VC_VelocityX = -35;
  m_VC_EllipseEkfNavVelocity.VC_VelocityXAccuracy = -35;
  m_VC_EllipseEkfNavVelocity.VC_VelocityY = -35;
  m_VC_EllipseEkfNavVelocity.VC_VelocityYAccuracy = -35;
  m_VC_EllipseEkfNavVelocity.VC_VelocityZ = -35;
  m_VC_EllipseEkfNavVelocity.VC_VelocityZAccuracy = -35;
  m_VC_EllipseEulerAngles.VC_EulerAnglesRoll = -180;
  m_VC_EllipseEulerAngles.VC_EulerAnglesPitch = -180;
  m_VC_EllipseEulerAngles.VC_EulerAnglesYaw = -180;
}

void SendFd(message * m, int ch, int len)
{
  m.CAN = ch;
  m.FDF = 1;
  m.BRS = 0;
  m.DataLength = len;
  output(m);
}

void SendClassic(message * m, int ch, int len)
{
  m.CAN = ch;
  m.FDF = 0;
  m.BRS = 0;
  m.DLC = len;
  output(m);
}

void Send_BMS_Vitals()
{
  SendClassic(m_BMS_Vitals, CH_CHARGER, 1);
  SendFd(m_BMS_Vitals, CH_FDCAN, 1);
}

void Send_BMS_Faults()
{
  SendFd(m_BMS_Faults, CH_FDCAN, 1);
}

void Send_BMS_Warnings()
{
  SendFd(m_BMS_Warnings, CH_FDCAN, 1);
}

void Send_BMS_FaultsCounts()
{
  SendFd(m_BMS_FaultsCounts, CH_FDCAN, 2);
}

void Send_BMS_WarningsCounts()
{
  SendFd(m_BMS_WarningsCounts, CH_FDCAN, 2);
}

void Send_BMS_Info()
{
  SendFd(m_BMS_Info, CH_FDCAN, 1);
}

void Send_BMS_InfoCounts()
{
  SendFd(m_BMS_InfoCounts, CH_FDCAN, 2);
}

void Send_BMS_Debug()
{
  SendFd(m_BMS_Debug, CH_FDCAN, 16);
}

void Send_BMS_CommitInfo()
{
  SendFd(m_BMS_CommitInfo, CH_FDCAN, 5);
}

void Send_BMS_LatchStatus()
{
  SendClassic(m_BMS_LatchStatus, CH_CHARGER, 1);
  SendFd(m_BMS_LatchStatus, CH_FDCAN, 1);
}

void Send_BMS_Contactors()
{
  SendClassic(m_BMS_Contactors, CH_CHARGER, 1);
  SendFd(m_BMS_Contactors, CH_FDCAN, 1);
}

void Send_BMS_Charger()
{
  SendClassic(m_BMS_Charger, CH_CHARGER, 1);
  SendFd(m_BMS_Charger, CH_FDCAN, 1);
}

void Send_BMS_TractiveSystem()
{
  SendClassic(m_BMS_TractiveSystem, CH_CHARGER, 7);
  SendFd(m_BMS_TractiveSystem, CH_FDCAN, 7);
}

void Send_BMS_BSPDStatus()
{
  SendFd(m_BMS_BSPDStatus, CH_FDCAN, 1);
}

void Send_BMS_HvBatteryProperties()
{
  SendFd(m_BMS_HvBatteryProperties, CH_FDCAN, 1);
}

void Send_BMS_ImdStatus()
{
  SendFd(m_BMS_ImdStatus, CH_FDCAN, 5);
}

void Send_BMS_ImdData()
{
  SendFd(m_BMS_ImdData, CH_FDCAN, 6);
}

void Send_BMS_PowerLimit()
{
  SendFd(m_BMS_PowerLimit, CH_FDCAN, 5);
}

void Send_BMS_Fans()
{
  SendFd(m_BMS_Fans, CH_FDCAN, 1);
}

void Send_BMS_BMSShdnNodeStatus()
{
  SendClassic(m_BMS_BMSShdnNodeStatus, CH_CHARGER, 1);
  SendFd(m_BMS_BMSShdnNodeStatus, CH_FDCAN, 1);
}

void Send_BMS_CPUDataLogInfo()
{
  SendFd(m_BMS_CPUDataLogInfo, CH_FDCAN, 48);
}

void Send_BMS_EvseCPStatus()
{
  SendClassic(m_BMS_EvseCPStatus, CH_CHARGER, 7);
  SendFd(m_BMS_EvseCPStatus, CH_FDCAN, 7);
}

void Send_BMS_ElconControls()
{
  SendClassic(m_BMS_ElconControls, CH_CHARGER, 5);
  SendFd(m_BMS_ElconControls, CH_FDCAN, 5);
}

void Send_Boot_BMS_Status()
{
  SendFd(m_Boot_BMS_Status, CH_FDCAN, 5);
}

void Send_Boot_VC_Status()
{
  SendFd(m_Boot_VC_Status, CH_FDCAN, 5);
}

void Send_Boot_DAM_Status()
{
  SendFd(m_Boot_DAM_Status, CH_FDCAN, 5);
}

void Send_Boot_FSM_Status()
{
  SendFd(m_Boot_FSM_Status, CH_FDCAN, 5);
}

void Send_Boot_RSM_Status()
{
  SendFd(m_Boot_RSM_Status, CH_FDCAN, 5);
}

void Send_Boot_CRIT_Status()
{
  SendFd(m_Boot_CRIT_Status, CH_FDCAN, 5);
}

void Send_CRIT_Vitals()
{
  SendFd(m_CRIT_Vitals, CH_FDCAN, 1);
}

void Send_CRIT_Debug()
{
  SendFd(m_CRIT_Debug, CH_FDCAN, 16);
}

void Send_CRIT_CommitInfo()
{
  SendFd(m_CRIT_CommitInfo, CH_FDCAN, 5);
}

void Send_CRIT_ButtonsAndSwitches()
{
  SendFd(m_CRIT_ButtonsAndSwitches, CH_FDCAN, 1);
}

void Send_CRIT_Warnings()
{
  SendFd(m_CRIT_Warnings, CH_FDCAN, 0);
}

void Send_CRIT_Faults()
{
  SendFd(m_CRIT_Faults, CH_FDCAN, 0);
}

void Send_CRIT_WarningsCounts()
{
  SendFd(m_CRIT_WarningsCounts, CH_FDCAN, 0);
}

void Send_CRIT_FaultsCounts()
{
  SendFd(m_CRIT_FaultsCounts, CH_FDCAN, 0);
}

void Send_CRIT_Info()
{
  SendFd(m_CRIT_Info, CH_FDCAN, 1);
}

void Send_CRIT_InfoCounts()
{
  SendFd(m_CRIT_InfoCounts, CH_FDCAN, 2);
}

void Send_CRIT_CPUDataLogInfo()
{
  SendFd(m_CRIT_CPUDataLogInfo, CH_FDCAN, 24);
}

void Send_DAM_Vitals()
{
  SendFd(m_DAM_Vitals, CH_FDCAN, 1);
}

void Send_DAM_Warnings()
{
  SendFd(m_DAM_Warnings, CH_FDCAN, 0);
}

void Send_DAM_Faults()
{
  SendFd(m_DAM_Faults, CH_FDCAN, 0);
}

void Send_DAM_WarningsCounts()
{
  SendFd(m_DAM_WarningsCounts, CH_FDCAN, 0);
}

void Send_DAM_FaultsCounts()
{
  SendFd(m_DAM_FaultsCounts, CH_FDCAN, 0);
}

void Send_DAM_Info()
{
  SendFd(m_DAM_Info, CH_FDCAN, 1);
}

void Send_DAM_InfoCounts()
{
  SendFd(m_DAM_InfoCounts, CH_FDCAN, 2);
}

void Send_DAM_Debug()
{
  SendFd(m_DAM_Debug, CH_FDCAN, 16);
}

void Send_DAM_CommitInfo()
{
  SendFd(m_DAM_CommitInfo, CH_FDCAN, 5);
}

void Send_DAM_ShdnNodeStatus()
{
  SendFd(m_DAM_ShdnNodeStatus, CH_FDCAN, 1);
}

void Send_DAM_CPUDataLogInfo()
{
  SendFd(m_DAM_CPUDataLogInfo, CH_FDCAN, 48);
}

void Send_Debug_CanMode()
{
  SendFd(m_Debug_CanMode, CH_FDCAN, 1);
}

void Send_Debug_Charging()
{
  SendFd(m_Debug_Charging, CH_FDCAN, 1);
}

void Send_Debug_CellBalancing()
{
  SendFd(m_Debug_CellBalancing, CH_FDCAN, 3);
}

void Send_Debug_ResetSoc()
{
  SendFd(m_Debug_ResetSoc, CH_FDCAN, 2);
}

void Send_Debug_SetBSPDTestCurrent()
{
  SendFd(m_Debug_SetBSPDTestCurrent, CH_FDCAN, 1);
}

void Send_Debug_SetTorqueRequest()
{
  SendFd(m_Debug_SetTorqueRequest, CH_FDCAN, 4);
}

void Send_EMeter_Measurement()
{
  SendClassic(m_EMeter_Measurement, CH_INVCAN, 8);
  if (gSim_VC) // VC forwards InvCAN -> FDCAN
    SendFd(m_EMeter_Measurement, CH_FDCAN, 8);
}

void Send_EMeter_Status()
{
  SendClassic(m_EMeter_Status, CH_INVCAN, 5);
  if (gSim_VC) // VC forwards InvCAN -> FDCAN
    SendFd(m_EMeter_Status, CH_FDCAN, 5);
}

void Send_EMeter_Temperature()
{
  SendClassic(m_EMeter_Temperature, CH_INVCAN, 8);
  if (gSim_VC) // VC forwards InvCAN -> FDCAN
    SendFd(m_EMeter_Temperature, CH_FDCAN, 8);
}

void Send_Elcon_Vitals()
{
  SendClassic(m_Elcon_Vitals, CH_CHARGER, 8);
  if (gSim_BMS) // BMS forwards charger -> FDCAN
    SendFd(m_Elcon_Vitals, CH_FDCAN, 8);
}

void Send_FSM_Vitals()
{
  SendFd(m_FSM_Vitals, CH_FDCAN, 1);
}

void Send_FSM_Warnings()
{
  SendFd(m_FSM_Warnings, CH_FDCAN, 1);
}

void Send_FSM_Faults()
{
  SendFd(m_FSM_Faults, CH_FDCAN, 0);
}

void Send_FSM_WarningsCounts()
{
  SendFd(m_FSM_WarningsCounts, CH_FDCAN, 2);
}

void Send_FSM_FaultsCounts()
{
  SendFd(m_FSM_FaultsCounts, CH_FDCAN, 0);
}

void Send_FSM_Info()
{
  SendFd(m_FSM_Info, CH_FDCAN, 2);
}

void Send_FSM_InfoCounts()
{
  SendFd(m_FSM_InfoCounts, CH_FDCAN, 3);
}

void Send_FSM_Debug()
{
  SendFd(m_FSM_Debug, CH_FDCAN, 16);
}

void Send_FSM_CommitInfo()
{
  SendFd(m_FSM_CommitInfo, CH_FDCAN, 5);
}

void Send_FSM_Steering()
{
  SendFd(m_FSM_Steering, CH_FDCAN, 2);
}

void Send_FSM_Apps()
{
  SendFd(m_FSM_Apps, CH_FDCAN, 5);
}

void Send_FSM_Brake()
{
  SendFd(m_FSM_Brake, CH_FDCAN, 2);
}

void Send_FSM_Suspension()
{
  SendFd(m_FSM_Suspension, CH_FDCAN, 3);
}

void Send_FSM_IMU()
{
  SendFd(m_FSM_IMU, CH_FDCAN, 12);
}

void Send_FSM_ShdnNodeStatus()
{
  SendFd(m_FSM_ShdnNodeStatus, CH_FDCAN, 1);
}

void Send_FSM_CPUDataLogInfo()
{
  SendFd(m_FSM_CPUDataLogInfo, CH_FDCAN, 24);
}

void Send_INVFL_FLInverterInfo1()
{
  SendClassic(m_INVFL_FLInverterInfo1, CH_INVCAN, 8);
  if (gSim_VC) // VC forwards InvCAN -> FDCAN
    SendFd(m_INVFL_FLInverterInfo1, CH_FDCAN, 8);
}

void Send_INVFL_FLInverterInfo2()
{
  SendClassic(m_INVFL_FLInverterInfo2, CH_INVCAN, 8);
  if (gSim_VC) // VC forwards InvCAN -> FDCAN
    SendFd(m_INVFL_FLInverterInfo2, CH_FDCAN, 8);
}

void Send_INVFL_FLInverterInfo3()
{
  SendClassic(m_INVFL_FLInverterInfo3, CH_INVCAN, 8);
  if (gSim_VC) // VC forwards InvCAN -> FDCAN
    SendFd(m_INVFL_FLInverterInfo3, CH_FDCAN, 8);
}

void Send_INVFR_FRInverterInfo1()
{
  SendClassic(m_INVFR_FRInverterInfo1, CH_INVCAN, 8);
  if (gSim_VC) // VC forwards InvCAN -> FDCAN
    SendFd(m_INVFR_FRInverterInfo1, CH_FDCAN, 8);
}

void Send_INVFR_FRInverterInfo2()
{
  SendClassic(m_INVFR_FRInverterInfo2, CH_INVCAN, 8);
  if (gSim_VC) // VC forwards InvCAN -> FDCAN
    SendFd(m_INVFR_FRInverterInfo2, CH_FDCAN, 8);
}

void Send_INVFR_FRInverterInfo3()
{
  SendClassic(m_INVFR_FRInverterInfo3, CH_INVCAN, 8);
  if (gSim_VC) // VC forwards InvCAN -> FDCAN
    SendFd(m_INVFR_FRInverterInfo3, CH_FDCAN, 8);
}

void Send_INVRL_RLInverterInfo1()
{
  SendClassic(m_INVRL_RLInverterInfo1, CH_INVCAN, 8);
  if (gSim_VC) // VC forwards InvCAN -> FDCAN
    SendFd(m_INVRL_RLInverterInfo1, CH_FDCAN, 8);
}

void Send_INVRL_RLInverterInfo2()
{
  SendClassic(m_INVRL_RLInverterInfo2, CH_INVCAN, 8);
  if (gSim_VC) // VC forwards InvCAN -> FDCAN
    SendFd(m_INVRL_RLInverterInfo2, CH_FDCAN, 8);
}

void Send_INVRL_RLInverterInfo3()
{
  SendClassic(m_INVRL_RLInverterInfo3, CH_INVCAN, 8);
  if (gSim_VC) // VC forwards InvCAN -> FDCAN
    SendFd(m_INVRL_RLInverterInfo3, CH_FDCAN, 8);
}

void Send_INVRR_RRInverterInfo1()
{
  SendClassic(m_INVRR_RRInverterInfo1, CH_INVCAN, 8);
  if (gSim_VC) // VC forwards InvCAN -> FDCAN
    SendFd(m_INVRR_RRInverterInfo1, CH_FDCAN, 8);
}

void Send_INVRR_RRInverterInfo2()
{
  SendClassic(m_INVRR_RRInverterInfo2, CH_INVCAN, 8);
  if (gSim_VC) // VC forwards InvCAN -> FDCAN
    SendFd(m_INVRR_RRInverterInfo2, CH_FDCAN, 8);
}

void Send_INVRR_RRInverterInfo3()
{
  SendClassic(m_INVRR_RRInverterInfo3, CH_INVCAN, 8);
  if (gSim_VC) // VC forwards InvCAN -> FDCAN
    SendFd(m_INVRR_RRInverterInfo3, CH_FDCAN, 8);
}

void Send_RSM_Vitals()
{
  SendFd(m_RSM_Vitals, CH_FDCAN, 1);
}

void Send_RSM_Faults()
{
  SendFd(m_RSM_Faults, CH_FDCAN, 0);
}

void Send_RSM_Warnings()
{
  SendFd(m_RSM_Warnings, CH_FDCAN, 0);
}

void Send_RSM_FaultsCounts()
{
  SendFd(m_RSM_FaultsCounts, CH_FDCAN, 0);
}

void Send_RSM_WarningsCounts()
{
  SendFd(m_RSM_WarningsCounts, CH_FDCAN, 0);
}

void Send_RSM_Info()
{
  SendFd(m_RSM_Info, CH_FDCAN, 2);
}

void Send_RSM_InfoCounts()
{
  SendFd(m_RSM_InfoCounts, CH_FDCAN, 3);
}

void Send_RSM_Debug()
{
  SendFd(m_RSM_Debug, CH_FDCAN, 16);
}

void Send_RSM_CommitInfo()
{
  SendFd(m_RSM_CommitInfo, CH_FDCAN, 5);
}

void Send_RSM_SuspensionTravel()
{
  SendFd(m_RSM_SuspensionTravel, CH_FDCAN, 2);
}

void Send_RSM_IMU()
{
  SendFd(m_RSM_IMU, CH_FDCAN, 12);
}

void Send_RSM_Brakes()
{
  SendFd(m_RSM_Brakes, CH_FDCAN, 2);
}

void Send_RSM_ShdnNodeStatus()
{
  SendFd(m_RSM_ShdnNodeStatus, CH_FDCAN, 1);
}

void Send_RSM_RearLeftPumpPercentage()
{
  SendFd(m_RSM_RearLeftPumpPercentage, CH_FDCAN, 1);
}

void Send_RSM_CPUDataLogInfo()
{
  SendFd(m_RSM_CPUDataLogInfo, CH_FDCAN, 24);
}

void Send_RSM_Coolant()
{
  SendFd(m_RSM_Coolant, CH_FDCAN, 2);
}

void Send_RSM_TireSensor()
{
  SendFd(m_RSM_TireSensor, CH_FDCAN, 2);
}

void Send_VC_INVFLSetPoints()
{
  SendClassic(m_VC_INVFLSetPoints, CH_INVCAN, 8);
  SendFd(m_VC_INVFLSetPoints, CH_FDCAN, 8);
}

void Send_VC_INVFRSetPoints()
{
  SendClassic(m_VC_INVFRSetPoints, CH_INVCAN, 8);
  SendFd(m_VC_INVFRSetPoints, CH_FDCAN, 8);
}

void Send_VC_INVRLSetPoints()
{
  SendClassic(m_VC_INVRLSetPoints, CH_INVCAN, 8);
  SendFd(m_VC_INVRLSetPoints, CH_FDCAN, 8);
}

void Send_VC_INVRRSetPoints()
{
  SendClassic(m_VC_INVRRSetPoints, CH_INVCAN, 8);
  SendFd(m_VC_INVRRSetPoints, CH_FDCAN, 8);
}

void Send_VC_Vitals()
{
  SendFd(m_VC_Vitals, CH_FDCAN, 2);
}

void Send_VC_Faults()
{
  SendFd(m_VC_Faults, CH_FDCAN, 1);
}

void Send_VC_Warnings()
{
  SendFd(m_VC_Warnings, CH_FDCAN, 2);
}

void Send_VC_FaultsCounts()
{
  SendFd(m_VC_FaultsCounts, CH_FDCAN, 1);
}

void Send_VC_WarningsCounts()
{
  SendFd(m_VC_WarningsCounts, CH_FDCAN, 2);
}

void Send_VC_Info()
{
  SendFd(m_VC_Info, CH_FDCAN, 3);
}

void Send_VC_InfoCounts()
{
  SendFd(m_VC_InfoCounts, CH_FDCAN, 4);
}

void Send_VC_Debug()
{
  SendFd(m_VC_Debug, CH_FDCAN, 16);
}

void Send_VC_CommitInfo()
{
  SendFd(m_VC_CommitInfo, CH_FDCAN, 5);
}

void Send_VC_VehicleDynamics()
{
  SendFd(m_VC_VehicleDynamics, CH_FDCAN, 7);
}

void Send_VC_IMU1()
{
  SendFd(m_VC_IMU1, CH_FDCAN, 12);
}

void Send_VC_EllipseEkfNavVelocity()
{
  SendFd(m_VC_EllipseEkfNavVelocity, CH_FDCAN, 16);
}

void Send_VC_GlobalShdnNodeStatus()
{
  SendFd(m_VC_GlobalShdnNodeStatus, CH_FDCAN, 1);
}

void Send_VC_PumpStatus()
{
  SendFd(m_VC_PumpStatus, CH_FDCAN, 2);
}

void Send_VC_ConnectorBoardEfuse()
{
  SendFd(m_VC_ConnectorBoardEfuse, CH_FDCAN, 12);
}

void Send_VC_ShdnNodeStatus()
{
  SendFd(m_VC_ShdnNodeStatus, CH_FDCAN, 1);
}

void Send_VC_EllipseTime()
{
  SendFd(m_VC_EllipseTime, CH_FDCAN, 4);
}

void Send_VC_EllipseStatus()
{
  SendFd(m_VC_EllipseStatus, CH_FDCAN, 8);
}

void Send_VC_EllipseEulerAngles()
{
  SendFd(m_VC_EllipseEulerAngles, CH_FDCAN, 6);
}

void Send_VC_MainBoardEfuse()
{
  SendFd(m_VC_MainBoardEfuse, CH_FDCAN, 20);
}

void Send_VC_CPUDataLogInfo()
{
  SendFd(m_VC_CPUDataLogInfo, CH_FDCAN, 48);
}

void Send_VC_PCM()
{
  SendFd(m_VC_PCM, CH_FDCAN, 1);
}

on timer tCycle_10ms
{
  if (gSim_BMS) Send_BMS_Vitals();
  if (gSim_BMS) Send_BMS_LatchStatus();
  if (gSim_BMS) Send_BMS_Contactors();
  if (gSim_BMS) Send_BMS_TractiveSystem();
  if (gSim_BMS) Send_BMS_BSPDStatus();
  if (gSim_BMS) Send_BMS_ImdStatus();
  if (gSim_BMS) Send_BMS_PowerLimit();
  if (gSim_BMS) Send_BMS_EvseCPStatus();
  if (gSim_DAM) Send_DAM_ShdnNodeStatus();
  if (gSim_Debug) Send_Debug_SetTorqueRequest();
  if (gSim_FSM) Send_FSM_Steering();
  if (gSim_FSM) Send_FSM_Apps();
  if (gSim_FSM) Send_FSM_Brake();
  if (gSim_FSM) Send_FSM_IMU();
  if (gSim_FSM) Send_FSM_ShdnNodeStatus();
  if (gSim_INVFL) Send_INVFL_FLInverterInfo1();
  if (gSim_INVFL) Send_INVFL_FLInverterInfo2();
  if (gSim_INVFL) Send_INVFL_FLInverterInfo3();
  if (gSim_INVFR) Send_INVFR_FRInverterInfo1();
  if (gSim_INVFR) Send_INVFR_FRInverterInfo2();
  if (gSim_INVFR) Send_INVFR_FRInverterInfo3();
  if (gSim_INVRL) Send_INVRL_RLInverterInfo1();
  if (gSim_INVRL) Send_INVRL_RLInverterInfo2();
  if (gSim_INVRL) Send_INVRL_RLInverterInfo3();
  if (gSim_INVRR) Send_INVRR_RRInverterInfo1();
  if (gSim_INVRR) Send_INVRR_RRInverterInfo2();
  if (gSim_INVRR) Send_INVRR_RRInverterInfo3();
  if (gSim_RSM) Send_RSM_IMU();
  if (gSim_VC) Send_VC_INVFLSetPoints();
  if (gSim_VC) Send_VC_INVFRSetPoints();
  if (gSim_VC) Send_VC_INVRLSetPoints();
  if (gSim_VC) Send_VC_INVRRSetPoints();
  if (gSim_VC) Send_VC_Vitals();
  if (gSim_VC) Send_VC_IMU1();
  if (gSim_VC) Send_VC_PumpStatus();
  if (gSim_VC) Send_VC_ConnectorBoardEfuse();
  if (gSim_VC) Send_VC_ShdnNodeStatus();
  if (gSim_VC) Send_VC_MainBoardEfuse();
  if (gSim_VC) Send_VC_PCM();
}

on timer tCycle_20ms
{
  if (gSim_EMeter) Send_EMeter_Measurement();
}

on timer tCycle_100ms
{
  if (gSim_BMS) Send_BMS_Faults();
  if (gSim_BMS) Send_BMS_Warnings();
  if (gSim_BMS) Send_BMS_FaultsCounts();
  if (gSim_BMS) Send_BMS_WarningsCounts();
  if (gSim_BMS) Send_BMS_Info();
  if (gSim_BMS) Send_BMS_InfoCounts();
  if (gSim_BMS) Send_BMS_CommitInfo();
  if (gSim_BMS) Send_BMS_Charger();
  if (gSim_BMS) Send_BMS_Fans();
  if (gSim_BMS) Send_BMS_BMSShdnNodeStatus();
  if (gSim_BMS) Send_BMS_CPUDataLogInfo();
  if (gSim_Boot) Send_Boot_BMS_Status();
  if (gSim_Boot) Send_Boot_VC_Status();
  if (gSim_Boot) Send_Boot_DAM_Status();
  if (gSim_Boot) Send_Boot_FSM_Status();
  if (gSim_Boot) Send_Boot_RSM_Status();
  if (gSim_Boot) Send_Boot_CRIT_Status();
  if (gSim_CRIT) Send_CRIT_Vitals();
  if (gSim_CRIT) Send_CRIT_CommitInfo();
  if (gSim_CRIT) Send_CRIT_ButtonsAndSwitches();
  if (gSim_CRIT) Send_CRIT_Warnings();
  if (gSim_CRIT) Send_CRIT_Faults();
  if (gSim_CRIT) Send_CRIT_WarningsCounts();
  if (gSim_CRIT) Send_CRIT_FaultsCounts();
  if (gSim_CRIT) Send_CRIT_Info();
  if (gSim_CRIT) Send_CRIT_InfoCounts();
  if (gSim_CRIT) Send_CRIT_CPUDataLogInfo();
  if (gSim_DAM) Send_DAM_Vitals();
  if (gSim_DAM) Send_DAM_Warnings();
  if (gSim_DAM) Send_DAM_Faults();
  if (gSim_DAM) Send_DAM_WarningsCounts();
  if (gSim_DAM) Send_DAM_FaultsCounts();
  if (gSim_DAM) Send_DAM_Info();
  if (gSim_DAM) Send_DAM_InfoCounts();
  if (gSim_DAM) Send_DAM_CommitInfo();
  if (gSim_DAM) Send_DAM_CPUDataLogInfo();
  if (gSim_Debug) Send_Debug_Charging();
  if (gSim_Debug) Send_Debug_ResetSoc();
  if (gSim_Debug) Send_Debug_SetBSPDTestCurrent();
  if (gSim_EMeter) Send_EMeter_Status();
  if (gSim_FSM) Send_FSM_Vitals();
  if (gSim_FSM) Send_FSM_Warnings();
  if (gSim_FSM) Send_FSM_Faults();
  if (gSim_FSM) Send_FSM_WarningsCounts();
  if (gSim_FSM) Send_FSM_FaultsCounts();
  if (gSim_FSM) Send_FSM_Info();
  if (gSim_FSM) Send_FSM_InfoCounts();
  if (gSim_FSM) Send_FSM_CommitInfo();
  if (gSim_FSM) Send_FSM_Suspension();
  if (gSim_FSM) Send_FSM_CPUDataLogInfo();
  if (gSim_RSM) Send_RSM_Vitals();
  if (gSim_RSM) Send_RSM_Faults();
  if (gSim_RSM) Send_RSM_Warnings();
  if (gSim_RSM) Send_RSM_FaultsCounts();
  if (gSim_RSM) Send_RSM_WarningsCounts();
  if (gSim_RSM) Send_RSM_Info();
  if (gSim_RSM) Send_RSM_InfoCounts();
  if (gSim_RSM) Send_RSM_Brakes();
  if (gSim_RSM) Send_RSM_ShdnNodeStatus();
  if (gSim_RSM) Send_RSM_RearLeftPumpPercentage();
  if (gSim_RSM) Send_RSM_CPUDataLogInfo();
  if (gSim_VC) Send_VC_Faults();
  if (gSim_VC) Send_VC_Warnings();
  if (gSim_VC) Send_VC_FaultsCounts();
  if (gSim_VC) Send_VC_WarningsCounts();
  if (gSim_VC) Send_VC_Info();
  if (gSim_VC) Send_VC_InfoCounts();
  if (gSim_VC) Send_VC_CommitInfo();
  if (gSim_VC) Send_VC_VehicleDynamics();
  if (gSim_VC) Send_VC_EllipseEkfNavVelocity();
  if (gSim_VC) Send_VC_GlobalShdnNodeStatus();
  if (gSim_VC) Send_VC_EllipseTime();
  if (gSim_VC) Send_VC_EllipseStatus();
  if (gSim_VC) Send_VC_EllipseEulerAngles();
  if (gSim_VC) Send_VC_CPUDataLogInfo();
}

on timer tCycle_250ms
{
  if (gSim_EMeter) Send_EMeter_Temperature();
}

on timer tCycle_1000ms
{
  if (gSim_BMS) Send_BMS_Debug();
  if (gSim_BMS) Send_BMS_HvBatteryProperties();
  if (gSim_BMS) Send_BMS_ImdData();
  if (gSim_BMS) Send_BMS_ElconControls();
  if (gSim_CRIT) Send_CRIT_Debug();
  if (gSim_DAM) Send_DAM_Debug();
  if (gSim_Debug) Send_Debug_CanMode();
  if (gSim_Debug) Send_Debug_CellBalancing();
  if (gSim_Elcon) Send_Elcon_Vitals();
  if (gSim_FSM) Send_FSM_Debug();
  if (gSim_RSM) Send_RSM_Debug();
  if (gSim_RSM) Send_RSM_CommitInfo();
  if (gSim_RSM) Send_RSM_SuspensionTravel();
  if (gSim_RSM) Send_RSM_Coolant();
  if (gSim_RSM) Send_RSM_TireSensor();
  if (gSim_VC) Send_VC_Debug();
}

on message EMeter_Measurement
{
  message * f;
  if (this.dir != RX) return;
  if (gSim_VC && !gSim_EMeter && this.CAN == CH_INVCAN)
  {
    f = this;
    SendFd(f, CH_FDCAN, 8);
  }
}

on message INVFL_FLInverterInfo1
{
  message * f;
  if (this.dir != RX) return;
  if (gSim_VC && !gSim_INVFL && this.CAN == CH_INVCAN)
  {
    f = this;
    SendFd(f, CH_FDCAN, 8);
  }
}

on message INVFR_FRInverterInfo1
{
  message * f;
  if (this.dir != RX) return;
  if (gSim_VC && !gSim_INVFR && this.CAN == CH_INVCAN)
  {
    f = this;
    SendFd(f, CH_FDCAN, 8);
  }
}

on message INVFL_FLInverterInfo2
{
  message * f;
  if (this.dir != RX) return;
  if (gSim_VC && !gSim_INVFL && this.CAN == CH_INVCAN)
  {
    f = this;
    SendFd(f, CH_FDCAN, 8);
  }
}

on message INVFR_FRInverterInfo2
{
  message * f;
  if (this.dir != RX) return;
  if (gSim_VC && !gSim_INVFR && this.CAN == CH_INVCAN)
  {
    f = this;
    SendFd(f, CH_FDCAN, 8);
  }
}

on message INVRL_RLInverterInfo1
{
  message * f;
  if (this.dir != RX) return;
  if (gSim_VC && !gSim_INVRL && this.CAN == CH_INVCAN)
  {
    f = this;
    SendFd(f, CH_FDCAN, 8);
  }
}

on message INVRR_RRInverterInfo1
{
  message * f;
  if (this.dir != RX) return;
  if (gSim_VC && !gSim_INVRR && this.CAN == CH_INVCAN)
  {
    f = this;
    SendFd(f, CH_FDCAN, 8);
  }
}

on message INVRL_RLInverterInfo2
{
  message * f;
  if (this.dir != RX) return;
  if (gSim_VC && !gSim_INVRL && this.CAN == CH_INVCAN)
  {
    f = this;
    SendFd(f, CH_FDCAN, 8);
  }
}

on message INVRR_RRInverterInfo2
{
  message * f;
  if (this.dir != RX) return;
  if (gSim_VC && !gSim_INVRR && this.CAN == CH_INVCAN)
  {
    f = this;
    SendFd(f, CH_FDCAN, 8);
  }
}

on message INVFL_FLInverterInfo3
{
  message * f;
  if (this.dir != RX) return;
  if (gSim_VC && !gSim_INVFL && this.CAN == CH_INVCAN)
  {
    f = this;
    SendFd(f, CH_FDCAN, 8);
  }
}

on message INVFR_FRInverterInfo3
{
  message * f;
  if (this.dir != RX) return;
  if (gSim_VC && !gSim_INVFR && this.CAN == CH_INVCAN)
  {
    f = this;
    SendFd(f, CH_FDCAN, 8);
  }
}

on message INVRR_RRInverterInfo3
{
  message * f;
  if (this.dir != RX) return;
  if (gSim_VC && !gSim_INVRR && this.CAN == CH_INVCAN)
  {
    f = this;
    SendFd(f, CH_FDCAN, 8);
  }
}

on message INVRL_RLInverterInfo3
{
  message * f;
  if (this.dir != RX) return;
  if (gSim_VC && !gSim_INVRL && this.CAN == CH_INVCAN)
  {
    f = this;
    SendFd(f, CH_FDCAN, 8);
  }
}

on message EMeter_Status
{
  message * f;
  if (this.dir != RX) return;
  if (gSim_VC && !gSim_EMeter && this.CAN == CH_INVCAN)
  {
    f = this;
    SendFd(f, CH_FDCAN, 5);
  }
}

on message EMeter_Temperature
{
  message * f;
  if (this.dir != RX) return;
  if (gSim_VC && !gSim_EMeter && this.CAN == CH_INVCAN)
  {
    f = this;
    SendFd(f, CH_FDCAN, 8);
  }
}

on message Elcon_Vitals
{
  message * f;
  if (this.dir != RX) return;
  if (gSim_BMS && !gSim_Elcon && this.CAN == CH_CHARGER)
  {
    f = this;
    SendFd(f, CH_FDCAN, 8);
  }
}

on start
{
  InitMessages();
  setTimerCyclic(tCycle_10ms, 10);
  setTimerCyclic(tCycle_20ms, 20);
  setTimerCyclic(tCycle_100ms, 100);
  setTimerCyclic(tCycle_250ms, 250);
  setTimerCyclic(tCycle_1000ms, 1000);
  write("hexray rest-bus sim: 132 periodic messages, 5 cycle groups");
}

on stopMeasurement
{
  cancelTimer(tCycle_10ms);
  cancelTimer(tCycle_20ms);
  cancelTimer(tCycle_100ms);
  cancelTimer(tCycle_250ms);
  cancelTimer(tCycle_1000ms);
}

/*
 * Not sent by this script: 138 event-driven messages (no GenMsgCycleTime),
 * e.g. bootloader traffic, Bootup and Debug commands. Send them from the Interactive
 * Generator or add handlers here:
 *   BMS        0x198 BMS_Bootup
 *   BMS        0x1A3 BMS_CellVoltageStats
 *   BMS        0x1A4 BMS_CellTempStats
 *   BMS        0x1A5 BMS_SegmentVoltageStats
 *   BMS        0x1A6 BMS_CellVoltages_Seg0_Seg1
 *   BMS        0x1A7 BMS_CellVoltages_Seg2_Seg3
 *   BMS        0x1A8 BMS_CellVoltages_Seg4_Seg5
 *   BMS        0x1AA BMS_CellVoltages_Seg6_Seg7
 *   BMS        0x1AB BMS_CellVoltages_Seg8_Seg9
 *   BMS        0x1AC BMS_CellTemps_Seg0_Seg1
 *   BMS        0x1AD BMS_CellTemps_Seg2_Seg3
 *   BMS        0x1AE BMS_CellTemps_Seg4_Seg5
 *   BMS        0x1AF BMS_CellOpenWireCheckOk
 *   BMS        0x1B0 BMS_ThermistorOpenWireCheckOk
 *   BMS        0x1B3 BMS_SegmentVref2
 *   BMS        0x1B4 BMS_SegmentITMP
 *   BMS        0x1B5 BMS_SegmentVD
 *   BMS        0x1B6 BMS_SegmentVA
 *   BMS        0x1B7 BMS_SegmentVRES
 *   BMS        0x1B8 BMS_SegmentVA_OV
 *   BMS        0x1B9 BMS_SegmentVA_UV
 *   BMS        0x1BA BMS_SegmentVD_OV
 *   BMS        0x1BB BMS_CellOverVoltage
 *   BMS        0x1BC BMS_CellUnderVoltage
 *   BMS        0x1BD BMS_SegmentVoltages
 *   BMS        0x1BF BMS_SegmentVD_UV
 *   BMS        0x1C0 BMS_SegmentCED
 *   BMS        0x1C1 BMS_SegmentCMED
 *   BMS        0x1C2 BMS_SegmentSED
 *   BMS        0x1C3 BMS_SegmentSMED
 *   BMS        0x1C4 BMS_SegmentVDE
 *   BMS        0x1C5 BMS_SegmentVDEL
 *   BMS        0x1C6 BMS_SegmentTHSD
 *   BMS        0x1C7 BMS_SegmentTMODCHK
 *   BMS        0x1C8 BMS_SegmentOSCCHK
 *   BMS        0x1C9 BMS_SegmentCMDCNT
 *   BMS        0x1CA BMS_CellVoltageErrors_Seg0_Seg3
 *   BMS        0x1CB BMS_CellVoltageErrors_Seg4_Seg7
 *   BMS        0x1CC BMS_CellVoltageErrors_Seg8_Seg9
 *   BMS        0x1CD BMS_CellTempErrors_Seg0_Seg3
 *   BMS        0x1CE BMS_CellTempErrors_Seg4_Seg7
 *   BMS        0x1CF BMS_CellTempErrors_Seg8_Seg9
 *   BMS        0x1D0 BMS_CellOpenWireCheckErrors_Seg0_Seg3
 *   BMS        0x1D1 BMS_CellOpenWireCheckErrors_Seg4_Seg7
 *   BMS        0x1D2 BMS_CellOpenWireCheckErrors_Seg8_Seg9
 *   BMS        0x1D3 BMS_ThermistorOpenWireCheckErrors_Seg0_Seg3
 *   BMS        0x1D4 BMS_ThermistorOpenWireCheckErrors_Seg4_Seg7
 *   BMS        0x1D5 BMS_ThermistorOpenWireCheckErrors_Seg8_Seg9
 *   BMS        0x1D6 BMS_SegmentVoltageErrors
 *   BMS        0x1D7 BMS_SegmentStatAErrors
 *   BMS        0x1D8 BMS_SegmentStatBErrors
 *   BMS        0x1D9 BMS_SegmentStatCErrors
 *   BMS        0x1DA BMS_SegmentStatDErrors
 *   BMS        0x1DB BMS_SegmentHealthErrors
 *   BMS        0x1DC BMS_CellDischargeEnabled
 *   BMS        0x1DD BMS_CellPwmDuty_Seg0_Seg3
 *   BMS        0x1DE BMS_CellPwmDuty_Seg4_Seg7
 *   BMS        0x1DF BMS_CellPwmDuty_Seg8_Seg9
 *   BMS        0x1E0 BMS_SpiLinkStatus
 *   BMS        0x1E1 BMS_PackVoltage
 *   BMS        0x1E3 BMS_CellTemps_Seg6_Seg7
 *   BMS        0x1E4 BMS_CellTemps_Seg8_Seg9
 *   Boot       0x4000001 Boot_BMS_SignalStart
 *   Boot       0x4000002 Boot_BMS_SignalStartACK
 *   Boot       0x4000003 Boot_BMS_UpdateGOTOAppCmd
 *   Boot       0x4000004 Boot_BMS_EraseSectorCmd
 *   Boot       0x4000005 Boot_BMS_EraseSectorCompleteCmd
 *   Boot       0x4000006 Boot_BMS_ProgramIdCmd
 *   Boot       0x4000007 Boot_BMS_VerifyIdCmd
 *   Boot       0x4000008 Boot_BMS_AppValidity
 *   Boot       0x4000009 Boot_BMS_GOTOBootCmd
 *   Boot       0x400000A Boot_BMS_EraseSectorFailed
 *   Boot       0x400000B Boot_BMS_ProgramSectorFailed
 *   Boot       0x8000001 Boot_VC_SignalStart
 *   Boot       0x8000002 Boot_VC_SignalStartACK
 *   Boot       0x8000003 Boot_VC_UpdateGOTOAppCmd
 *   Boot       0x8000004 Boot_VC_EraseSectorCmd
 *   Boot       0x8000005 Boot_VC_EraseSectorCompleteCmd
 *   Boot       0x8000006 Boot_VC_ProgramIdCmd
 *   Boot       0x8000007 Boot_VC_VerifyIdCmd
 *   Boot       0x8000008 Boot_VC_AppValidity
 *   Boot       0x8000009 Boot_VC_GOTOBootCmd
 *   Boot       0x800000A Boot_VC_EraseSectorFailed
 *   Boot       0x800000B Boot_VC_ProgramSectorFailed
 *   Boot       0xC000001 Boot_DAM_SignalStart
 *   Boot       0xC000002 Boot_DAM_SignalStartACK
 *   Boot       0xC000003 Boot_DAM_UpdateGOTOAppCmd
 *   Boot       0xC000004 Boot_DAM_EraseSectorCmd
 *   Boot       0xC000005 Boot_DAM_EraseSectorCompleteCmd
 *   Boot       0xC000006 Boot_DAM_ProgramIdCmd
 *   Boot       0xC000007 Boot_DAM_VerifyIdCmd
 *   Boot       0xC000008 Boot_DAM_AppValidity
 *   Boot       0xC000009 Boot_DAM_GOTOBootCmd
 *   Boot       0xC00000A Boot_DAM_EraseSectorFailed
 *   Boot       0xC00000B Boot_DAM_ProgramSectorFailed
 *   Boot       0x10000001 Boot_FSM_SignalStart
 *   Boot       0x10000002 Boot_FSM_SignalStartACK
 *   Boot       0x10000003 Boot_FSM_UpdateGOTOAppCmd
 *   Boot       0x10000004 Boot_FSM_EraseSectorCmd
 *   Boot       0x10000005 Boot_FSM_EraseSectorCompleteCmd
 *   Boot       0x10000006 Boot_FSM_ProgramIdCmd
 *   Boot       0x10000007 Boot_FSM_VerifyIdCmd
 *   Boot       0x10000008 Boot_FSM_AppValidity
 *   Boot       0x10000009 Boot_FSM_GOTOBootCmd
 *   Boot       0x1000000A Boot_FSM_EraseSectorFailed
 *   Boot       0x1000000B Boot_FSM_ProgramSectorFailed
 *   Boot       0x14000001 Boot_RSM_SignalStart
 *   Boot       0x14000002 Boot_RSM_SignalStartACK
 *   Boot       0x14000003 Boot_RSM_UpdateGOTOAppCmd
 *   Boot       0x14000004 Boot_RSM_EraseSectorCmd
 *   Boot       0x14000005 Boot_RSM_EraseSectorCompleteCmd
 *   Boot       0x14000006 Boot_RSM_ProgramIdCmd
 *   Boot       0x14000007 Boot_RSM_VerifyIdCmd
 *   Boot       0x14000008 Boot_RSM_AppValidity
 *   Boot       0x14000009 Boot_RSM_GOTOBootCmd
 *   Boot       0x1400000A Boot_RSM_EraseSectorFailed
 *   Boot       0x1400000B Boot_RSM_ProgramSectorFailed
 *   Boot       0x18000001 Boot_CRIT_SignalStart
 *   Boot       0x18000002 Boot_CRIT_SignalStartACK
 *   Boot       0x18000003 Boot_CRIT_UpdateGOTOAppCmd
 *   Boot       0x18000004 Boot_CRIT_EraseSectorCmd
 *   Boot       0x18000005 Boot_CRIT_EraseSectorCompleteCmd
 *   Boot       0x18000006 Boot_CRIT_ProgramIdCmd
 *   Boot       0x18000007 Boot_CRIT_VerifyIdCmd
 *   Boot       0x18000008 Boot_CRIT_AppValidity
 *   Boot       0x18000009 Boot_CRIT_GOTOBootCmd
 *   Boot       0x1800000A Boot_CRIT_EraseSectorFailed
 *   Boot       0x1800000B Boot_CRIT_ProgramSectorFailed
 *   CRIT       0x38C CRIT_Bootup
 *   DAM        0x328 DAM_Bootup
 *   FSM        0x260 FSM_Bootup
 *   RSM        0x2C4 RSM_Bootup
 *   VC         0x1FC VC_Bootup
 *   VC         0x230 VC_PowerMonitoring
 *   VC         0x231 VC_BatteryMonitoring_Faults
 *   VC         0x232 VC_BatteryMonitoring_Data
 *   VC         0x30D VC_EMeterTeamMessage1
 *   VC         0x30E VC_EMeterTeamMessage2
 */
