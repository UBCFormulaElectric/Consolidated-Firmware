VERSION ""
NS_ :

BS_:

BU_: DIM

BO_ 200 DIM_Test1: 2 DIM
SG_ Ex1 : 0|1@1+ (1,0) [0|1] "" DEBUG
SG_ Ex2 : 1|12@1+ (1,0) [0|4095] "" DEBUG

BO_ 201 DIM_Test2: 2 DIM
SG_ Ex3 : 0|14@1+ (0.1,0) [0|1000] "" DEBUG
SG_ Ex4 : 14|2@1+ (1,0) [0|2] "" DEBUG

BO_ 100 DIM_AlertSet: 0 DIM
SG_ DIM_AlertSet : 0|0@1+ (1,0) [0|0] "" DEBUG

BO_ 101 DIM_AlertCleared: 0 DIM
SG_ DIM_AlertCleared : 0|0@1+ (1,0) [0|0] "" DEBUG

BA_DEF_  "BusType" STRING ;
BA_DEF_DEF_  "BusType" "CAN";

BA_ "GenSigStartValue" SG_ 200 Ex1 0;
BA_ "GenSigStartValue" SG_ 200 Ex2 0;
BA_ "GenSigStartValue" SG_ 201 Ex3 0;
BA_ "GenSigStartValue" SG_ 201 Ex4 0;
BA_ "GenSigStartValue" SG_ 100 DIM_AlertSet 0;
BA_ "GenSigStartValue" SG_ 101 DIM_AlertCleared 0;

BA_ "GenMsgCycleTime" BO_ 200  1000;
BA_ "GenMsgCycleTime" BO_ 201  10;

VAL_ 201 Ex4 0 "CHOICE_0" 1 "CHOICE_1" 2 "CHOICE_2";
VAL_ 100 DIM_AlertSet 0 "NUM_DIM_ALERTS";
VAL_ 101 DIM_AlertCleared 0 "NUM_DIM_ALERTS";
