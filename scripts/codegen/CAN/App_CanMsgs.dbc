VERSION ""
NS_ :

BS_:

BU_: DIM

BO_ 100 DIM_AlertSet: 0 DIM
SG_ DIM_AlertSet : 0|0@1+ (1,0) [0|0] "" DEBUG

BO_ 101 DIM_AlertCleared: 0 DIM
SG_ DIM_AlertCleared : 0|0@1+ (1,0) [0|0] "" DEBUG

BA_DEF_  "BusType" STRING ;
BA_DEF_DEF_  "BusType" "CAN";

BA_ "GenSigStartValue" SG_ 100 DIM_AlertSet 0;
BA_ "GenSigStartValue" SG_ 101 DIM_AlertCleared 0;

VAL_ 100 DIM_AlertSet 0 "NUM_DIM_ALERTS";
VAL_ 101 DIM_AlertCleared 0 "NUM_DIM_ALERTS";
