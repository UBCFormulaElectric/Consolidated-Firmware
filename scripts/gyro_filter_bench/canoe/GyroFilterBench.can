/*@!Encoding:1252*/
/*
 * CANoe test module for the VC gyro Z filter bench (firmware/hexray/VC/src/bench/gyro_filter_bench.cpp).
 *
 * Needs can_bus/dbcs/hexray.dbc (regenerated by any VC build) on the FDCAN channel the VC is on, and a VC flashed
 * with -DVC_GYRO_FILTER_BENCH=ON.
 *
 * For every test step it sends Debug_GyroFilterBenchCmd, lets the board switch, then for the hold time:
 *   - writes every VC_GyroFilterBench frame to gyro_filter_bench.csv (next to the configuration) with the step number
 *     in the Run column, for scripts/gyro_filter_bench/gyro_filter_bench.py analyze
 *   - checks on the spot: frames every 20 ms with no counter gaps, the board echoes the commanded mode and cutoff,
 *     and on STEP every filter settles to exactly the input (DC gain 1)
 *
 * Keep the board still for the stationary live steps. The "twist" step asks you to rotate it about Z by hand.
 */

includes
{
}

variables
{
  // GyroBenchMode (can_bus/hexray/shared_enum.json)
  const int MODE_LIVE    = 0;
  const int MODE_SINE    = 1;
  const int MODE_CHIRP   = 2;
  const int MODE_STEP    = 3;
  const int MODE_IMPULSE = 4;
  const int MODE_NOISE   = 5;

  const dword FRAME_PERIOD_MS   = 20;
  const dword SWITCH_MS         = 500;  // command -> board restarted, before logging starts
  const int   STATIONARY_RUNS   = 5;
  const float AMPLITUDE_DPS     = 100.0;
  const float MAIN_CUTOFF_HZ    = 10.0;
  const float DC_TOLERANCE_DPS  = 0.05; // CAN carries 0.01 deg/s steps
  const int   SETTLED_FRAMES    = 50;   // input unchanged this long -> every filter must equal it (fc >= 2 Hz)

  message Debug_GyroFilterBenchCmd gCmd;

  dword gFile = 0;
  int   gRun  = 0;
  int   gLogging = 0;

  // Per-step checks
  int   gExpectedMode;
  float gExpectedCutoff;
  dword gFrames;
  dword gCounterGaps;
  dword gEchoErrors;
  int   gLastCounter;
  float gLastIn;
  dword gSameInFrames;
  dword gSettledChecks;
  dword gSettledErrors;
  float gWorstDcError;
}

float AbsF(float v)
{
  if (v < 0)
    return -v;
  return v;
}

void CheckSettled(float in, float out)
{
  float err;
  err = AbsF(out - in);
  if (err > gWorstDcError)
    gWorstDcError = err;
  if (err > DC_TOLERANCE_DPS)
    gSettledErrors++;
}

on message VC_GyroFilterBench
{
  char  line[256];
  int   counter;
  float in;

  if (!gLogging)
    return;

  counter = this.VC_GyroBenchCounter;
  in      = this.VC_GyroZIn.phys;

  if (gLastCounter >= 0 && counter != ((gLastCounter + 1) % 256))
    gCounterGaps++;
  gLastCounter = counter;
  gFrames++;

  if (this.VC_GyroBenchMode != gExpectedMode || AbsF(this.VC_GyroBenchCutoff.phys - gExpectedCutoff) > 0.01)
    gEchoErrors++;

  // DC gain: once the step input has held still long enough, all three outputs must equal it.
  if (gExpectedMode == MODE_STEP)
  {
    if (AbsF(in - gLastIn) < 0.001)
      gSameInFrames++;
    else
      gSameInFrames = 0;
    if (gSameInFrames >= SETTLED_FRAMES)
    {
      gSettledChecks++;
      CheckSettled(in, this.VC_GyroZEma.phys);
      CheckSettled(in, this.VC_GyroZButterworth.phys);
      CheckSettled(in, this.VC_GyroZBiquad.phys);
    }
  }
  gLastIn = in;

  snprintf(line, elcount(line), "%.6f;%d;%d;%d;%.1f;%.2f;%.2f;%.2f;%.2f\n",
           this.time / 100000.0, gRun, counter, (int)this.VC_GyroBenchMode, this.VC_GyroBenchCutoff.phys, in,
           this.VC_GyroZEma.phys, this.VC_GyroZButterworth.phys, this.VC_GyroZBiquad.phys);
  filePutString(line, strlen(line), gFile);
}

void SendCommand(int mode, float freqHz, float ampDps, float cutoffHz)
{
  gCmd.Debug_GyroBenchMode           = mode;
  gCmd.Debug_GyroBenchFrequency.phys = freqHz;
  gCmd.Debug_GyroBenchAmplitude.phys = ampDps;
  gCmd.Debug_GyroBenchCutoff.phys    = cutoffHz;
  output(gCmd);
}

/* Command one stimulus, log and check it for holdS seconds. */
void RunStep(char title[], int mode, float freqHz, float ampDps, float cutoffHz, float holdS)
{
  char  msg[256];
  dword expected;
  dword holdMs;

  gRun++;
  snprintf(msg, elcount(msg), "run %d: %s", gRun, title);
  TestStep("Command", msg);

  SendCommand(mode, freqHz, ampDps, cutoffHz);
  testWaitForTimeout(SWITCH_MS);
  SendCommand(mode, freqHz, ampDps, cutoffHz); // same command again: harmless, covers a lost frame

  gExpectedMode   = mode;
  gExpectedCutoff = cutoffHz;
  gFrames         = 0;
  gCounterGaps    = 0;
  gEchoErrors     = 0;
  gLastCounter    = -1;
  gSameInFrames   = 0;
  gSettledChecks  = 0;
  gSettledErrors  = 0;
  gWorstDcError   = 0;

  holdMs   = (dword)(holdS * 1000);
  gLogging = 1;
  testWaitForTimeout(holdMs);
  gLogging = 0;

  expected = holdMs / FRAME_PERIOD_MS;
  snprintf(msg, elcount(msg), "%d frames (expected %d), %d counter gap(s), %d echo error(s)", gFrames, expected,
           gCounterGaps, gEchoErrors);
  if (gFrames + 2 + expected / 50 >= expected && gFrames <= expected + 2 + expected / 50 && gCounterGaps == 0 &&
      gEchoErrors == 0)
    TestStepPass("Frames", msg);
  else
    TestStepFail("Frames", msg);

  if (mode == MODE_STEP)
  {
    snprintf(msg, elcount(msg), "%d settled frame(s) checked, worst |output - input| %.3f deg/s, %d over %.2f",
             gSettledChecks, gWorstDcError, gSettledErrors, DC_TOLERANCE_DPS);
    if (gSettledChecks > 0 && gSettledErrors == 0)
      TestStepPass("DC gain", msg);
    else
      TestStepFail("DC gain", msg);
  }
}

testcase TC_StationaryLive()
{
  int i;
  TestCaseTitle("TC1", "Live gyro Z, board still: IMU noise power reduction (repeated runs)");
  for (i = 0; i < STATIONARY_RUNS; i++)
    RunStep("live, board still", MODE_LIVE, 0, 0, MAIN_CUTOFF_HZ, 30);
}

testcase TC_TwistLive()
{
  TestCaseTitle("TC2", "Live gyro Z, board twisted by hand about Z");
  TestStep("Prompt", "Twist the board back and forth about Z (about 1-3 Hz, under 250 deg/s) for the next 30 s");
  RunStep("live, board twisted", MODE_LIVE, 0, 0, MAIN_CUTOFF_HZ, 30);
}

testcase TC_ImpulseCutoffSweep()
{
  TestCaseTitle("TC3", "Impulse at each cutoff: typical and max group delay");
  RunStep("impulse, fc 2 Hz", MODE_IMPULSE, 0, AMPLITUDE_DPS, 2, 20);
  RunStep("impulse, fc 3 Hz", MODE_IMPULSE, 0, AMPLITUDE_DPS, 3, 20);
  RunStep("impulse, fc 5 Hz", MODE_IMPULSE, 0, AMPLITUDE_DPS, 5, 20);
  RunStep("impulse, fc 8 Hz", MODE_IMPULSE, 0, AMPLITUDE_DPS, 8, 20);
  RunStep("impulse, fc 10 Hz", MODE_IMPULSE, 0, AMPLITUDE_DPS, 10, 20);
}

testcase TC_Step()
{
  TestCaseTitle("TC4", "Step: delay, rise, overshoot, settling, DC gain");
  RunStep("step", MODE_STEP, 0, AMPLITUDE_DPS, MAIN_CUTOFF_HZ, 20);
}

testcase TC_Chirp()
{
  TestCaseTitle("TC5", "Chirp 0.2-20 Hz: gain and phase vs frequency");
  RunStep("chirp", MODE_CHIRP, 0, AMPLITUDE_DPS, MAIN_CUTOFF_HZ, 80);
}

testcase TC_Noise()
{
  TestCaseTitle("TC6", "White noise: noise power ratio vs theory");
  RunStep("white noise", MODE_NOISE, 0, AMPLITUDE_DPS, MAIN_CUTOFF_HZ, 60);
}

testcase TC_Sines()
{
  TestCaseTitle("TC7", "Sines in the yaw band: gain and phase lag");
  RunStep("sine 1 Hz", MODE_SINE, 1, AMPLITUDE_DPS, MAIN_CUTOFF_HZ, 10);
  RunStep("sine 2 Hz", MODE_SINE, 2, AMPLITUDE_DPS, MAIN_CUTOFF_HZ, 10);
  RunStep("sine 3 Hz", MODE_SINE, 3, AMPLITUDE_DPS, MAIN_CUTOFF_HZ, 10);
  RunStep("sine 5 Hz", MODE_SINE, 5, AMPLITUDE_DPS, MAIN_CUTOFF_HZ, 10);
  RunStep("sine 8 Hz", MODE_SINE, 8, AMPLITUDE_DPS, MAIN_CUTOFF_HZ, 10);
}

void MainTest()
{
  char header[256];

  gFile = openFileWrite("gyro_filter_bench.csv", 0);
  if (gFile == 0)
  {
    TestStepFail("Setup", "could not open gyro_filter_bench.csv for writing");
    return;
  }
  strncpy(header, "Time [s];Run;VC_GyroBenchCounter;VC_GyroBenchMode;VC_GyroBenchCutoff [Hz];VC_GyroZIn [deg/s];VC_GyroZEma [deg/s];VC_GyroZButterworth [deg/s];VC_GyroZBiquad [deg/s]\n", elcount(header));
  filePutString(header, strlen(header), gFile);

  TC_StationaryLive();
  TC_TwistLive();
  TC_ImpulseCutoffSweep();
  TC_Step();
  TC_Chirp();
  TC_Noise();
  TC_Sines();

  // Leave the board filtering live gyro Z at the main cutoff.
  SendCommand(MODE_LIVE, 0, 0, MAIN_CUTOFF_HZ);
  fileClose(gFile);
  gFile = 0;
}
